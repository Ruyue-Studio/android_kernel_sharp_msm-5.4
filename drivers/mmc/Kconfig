## drivers/mmc/Kconfig
```kconfig
# SPDX-License-Identifier: GPL-2.0-only
#
# MMC subsystem configuration
#

menuconfig MMC
	tristate "MMC/SD/SDIO card support"
	depends on HAS_IOMEM
	help
	  This selects MultiMediaCard, Secure Digital and Secure
	  Digital I/O support.

	  If you want MMC/SD/SDIO support, you should say Y here and
	  also to your specific host controller driver.

config SHARP_MMC
	bool "SHARP MMC driver customized"
	depends on MMC
	default n

config SHARP_MMC_SD
	bool "SHARP SD driver customized"
	depends on SHARP_MMC
	default n

config SHARP_MMC_SD_BATTLOG
	bool "SHARP SD driver customized for logging"
	depends on SHARP_MMC_SD
	default n

if MMC

source "drivers/mmc/core/Kconfig"

source "drivers/mmc/host/Kconfig"

endif # MMC
```

## drivers/soc/qcom/sharp/pnp/Kconfig
```kconfig
# drivers/soc/qcom/sharp/pnp/Kconfig

menu "SHARP Power and Performance(PnP)"

config SHARP_PNP
	bool "SHARP PnP customize"
	default n

config SHARP_PNP_CPUFREQ_MODULE
	tristate "SHARP PnP cpufreq driver module support"
	default n

config SHARP_PNP_SLEEP
	bool "Enable SHARP PnP customize sleep"
	depends on SHARP_PNP
	default n

config SHARP_PNP_SLEEP_DEBUG
	bool "Enable SHARP PnP customize sleep debug"
	depends on SHARP_PNP
	default n

config SHARP_PNP_SLEEP_SLEEPLOG
	bool "Enable SHARP PnP customize sleep sleeplog"
	depends on SHARP_PNP
	default n

endmenu
```
